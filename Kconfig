## Kconfig
```kconfig
# zmk-layout-shift Kconfig

config LAYOUT_SHIFT
    bool "Layout Shift"
    default y
    select INPUT_PROCESSOR
    help
      Enable the Layout Shift module.

if LAYOUT_SHIFT

config LAYOUT_SHIFT_LOG_LEVEL
    int "Layout Shift Log Level"
    default 3
    help
      Set the log level for the Layout Shift module.
      0: OFF
      1: ERROR
      2: WARNING
      3: INFO
      4: DEBUG

endif # LAYOUT_SHIFT
```

## dts/bindings/behaviors/zmk,behavior-layout-shift-key-press.yaml
```yaml
# Copyright (c) 2024 The ZMK Contributors
# SPDX-License-Identifier: MIT

description: Layout shift custom key press behavior that converts all keys to 'A'

compatible: "zmk,behavior-layout-shift-key-press"

include: one_param.yaml
```

## dts/bindings/behaviors/zmk,behavior-layout-shift.yaml
```yaml
# Copyright (c) 2024 The ZMK Contributors
# SPDX-License-Identifier: MIT

description: Layout shift behavior for key transformation

compatible: "zmk,behavior-layout-shift"

include: behavior-base.yaml

properties:
  #include-path: /app/include/dt-bindings/zmk/keys.h
```
